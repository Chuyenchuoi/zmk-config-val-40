## config/boards/arm/val40/Kconfig.board
```kconfig
# Zaphod board configuration

# Copyright (c) 2020 Pete Johanson
# SPDX-License-Identifier: MIT

config BOARD_VAL40
	bool "Val40"
	depends on SOC_NRF52840_QIAA
```

## config/boards/arm/val40/Kconfig.defconfig
```kconfig
# Copyright (c) 2020 Pete Johanson
# SPDX-License-Identifier: MIT

if BOARD_VAL40

config BOARD
	default "val40"

config ZMK_KEYBOARD_NAME
	default "VAL40 Bluetooth"

if USB

config USB_NRFX
	default y

config USB_DEVICE_STACK
	default y

endif # USB

config BT_CTLR
	default BT

config ZMK_BLE
	default y

config ZMK_USB
	default y

config ZMK_EXT_POWER
	default y

config ZMK_BATTERY_VOLTAGE_DIVIDER
	default y

endif # BOARD_VAL40
```
